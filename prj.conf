## prj.conf
```kconfig
CONFIG_I2S=y

# choose UART console
CONFIG_UART_CONSOLE=y

# Debug config
CONFIG_LOG=y
CONFIG_LOG_BUFFER_SIZE=2048
CONFIG_LOG_DEFAULT_LEVEL=4
# RTT Viewer
CONFIG_USE_SEGGER_RTT=y
CONFIG_LOG_BACKEND_RTT=y
#CONFIG_LOG_BACKEND_RTT_MODE_DROP=y
CONFIG_LOG_PRINTK=y
```

## nrf5340dk_nrf5340_cpuapp_ns.overlay
```dts
// To get started, press Ctrl+Space to bring up the completion menu and view the available nodes.

// You can also use the buttons in the sidebar to perform actions on nodes.
// Actions currently available include:

// * Enabling / disabling the node
// * Adding the bus to a bus
// * Removing the node
// * Connecting ADC channels

// For more help, browse the DeviceTree documentation at https: //docs.zephyrproject.org/latest/guides/dts/index.html
// You can also visit the nRF DeviceTree extension documentation at https: //nrfconnect.github.io/vscode-nrf-connect/devicetree/nrfdevicetree.html
// https: //docs.zephyrproject.org/2.6.0/reference/devicetree/bindings/i2s/nordic%2Cnrf-i2s.html#dtbinding-nordic-nrf-i2s
```

## boards/nrf5340dk_nrf5340_cpuapp.overlay
```dts
&clock {
    hfclkaudio-frequency = <11289600>;
};

i2s_rxtx: &i2s0 {
    status = "okay";
    sck-pin = <47>;
    lrck-pin = <44>;
    sdout-pin = <45>;
    sdin-pin = <46>;
    clock-source = "ACLK";
};
```

## src/main.c
```c
#include <string.h>
#include <nrf.h>
#include <kernel.h>
#include <device.h>
#include <drivers/i2s.h>
#include <drivers/gpio.h>
#include "wav_file.h"

#include <logging/log.h>
#include <sys/printk.h>

/** Register log module */
LOG_MODULE_REGISTER(i2s);

/* Prepare for 32 sample values */
#define NUM_SAMPLES 32

/* Sine Wave Sample */
static int16_t data_frame[NUM_SAMPLES] = {
	  6392,  12539,  18204,  23169,  27244,  30272,  32137,  32767,  32137,
	 30272,  27244,  23169,  18204,  12539,   6392,      0,  -6393, -12540,
	-18205, -23170, -27245, -30273, -32138, -32767, -32138, -30273, -27245,
	-23170, -18205, -12540,  -6393,     -1,
};

/* The size of the memory block should be a multiple of data_frame size */
#define BLOCK_SIZE (2 * sizeof(data_frame))

/* The number of memory blocks in a slab has to be at least 2 per queue */
#define NUM_BLOCKS 5
#define J_LIMIT (sizeof(rawData) / (NUM_BLOCKS * NUM_SAMPLES * 2))

/* Define a new Memory Slab which consistes of NUM_BLOCKS blocks
   __________________________________________________________________________
  |    Block 0   |    Block 1   |    Block 2   |    Block 3   |    Block 4   |
  |    0...31    |    0...31    |    0...31    |    0...31    |    0...31    |
  |______________|______________|______________|______________|______________|
*/
static K_MEM_SLAB_DEFINE(mem_slab, BLOCK_SIZE, NUM_BLOCKS, NUM_SAMPLES);

static uint16_t j = 0;

void main(void) {

    /* Get I2S device from the devicetree */
	const struct device *i2s_dev = DEVICE_DT_GET(DT_NODELABEL(i2s_rxtx));
	if (!device_is_ready(i2s_dev)) {
		printk("%s is not ready\n", i2s_dev->name);
		return;
	}

	/* Configure the I2S device */
	struct i2s_config i2s_cfg;
	i2s_cfg.word_size = 16; // due to int16_t in data_frame declaration
	i2s_cfg.channels = 2; // L + R channel
	i2s_cfg.format = I2S_FMT_DATA_FORMAT_I2S;
	i2s_cfg.options = I2S_OPT_BIT_CLK_MASTER | I2S_OPT_FRAME_CLK_MASTER;
	i2s_cfg.frame_clk_freq = 44100;
	i2s_cfg.mem_slab = &mem_slab;
	i2s_cfg.block_size = BLOCK_SIZE;
	i2s_cfg.timeout = 1000;
	int ret = i2s_configure(i2s_dev, I2S_DIR_TX, &i2s_cfg);
	if (ret < 0) {
		printk("Failed to configure the I2S stream: (%d)\n", ret);
		return;
	}

	/* Allocate the memory blocks (tx buffer) from the slab and
	   set everything to 0 */
	void *mem_blocks;
	ret = k_mem_slab_alloc(&mem_slab, &mem_blocks, K_NO_WAIT);
	if (ret < 0) {
		printk("Failed to allocate the memory blocks: %d\n", ret);
		return;
	}
	//memset((uint16_t*)mem_blocks, 0, NUM_SAMPLES * NUM_BLOCKS);
    memset((uint16_t*)mem_blocks, 0, (NUM_SAMPLES * NUM_BLOCKS));

	/* Start the transmission of data */
	ret = i2s_trigger(i2s_dev, I2S_DIR_TX, I2S_TRIGGER_START);
	if (ret < 0) {
		printk("Failed to start the transmission: %d\n", ret);
		return;
	}

	for(;;) {
		/* Put data into the tx buffer */
		for (int i = 0; i < NUM_SAMPLES * NUM_BLOCKS; i++) {
			//((uint16_t*)mem_blocks)[i] = data_frame[i % NUM_SAMPLES];
            ((uint16_t*)mem_blocks)[i] = ((rawData[2 * (NUM_BLOCKS * NUM_SAMPLES) * j + 2*i+1]) << 8) | rawData[2 * (NUM_BLOCKS * NUM_SAMPLES) * j + 2*i];
            //LOG_INF("rawData[%d]: 0x%X", 2 * (NUM_BLOCKS * NUM_SAMPLES) * j + 2*i, rawData[2 * (NUM_BLOCKS * NUM_SAMPLES) * j + 2*i]);
            //LOG_INF("mem_blocks[%d]: 0x%X", i, ((uint16_t*)mem_blocks)[i]);
            if (j >= J_LIMIT){
                ((uint16_t*)mem_blocks)[i] = 0;
            }
		}

        j++;
        if (j >= 2*J_LIMIT){
            j = 0;
        }

		/* Write Data */
		int ret = i2s_buf_write(i2s_dev, mem_blocks, BLOCK_SIZE);
		if (ret < 0) {
			printk("Error: i2s_write failed with %d\n", ret);
			return;
		}
	}
}
```
